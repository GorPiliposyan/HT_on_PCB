#include <SPI.h>
#include <Adafruit_INA219.h>
#include <SD.h>
#define MUX_Address 0x70

//Adafruit_INA219 ina219_A1(0x40);
Adafruit_INA219 ina219_B1(0x41);
Adafruit_INA219 ina219_C1(0x44);
Adafruit_INA219 ina219_A2(0x40);
Adafruit_INA219 ina219_B2(0x41);
Adafruit_INA219 ina219_C2(0x44);


File PowConsFile;
//File debugFile;
//File TimingFile;
//File yPredFile;
const int chipSelect = 4;
//int alarm = 3;
#define HT_cont_pin  3
int alarm2 = 9;




// ///////////////Store ML related parameters////////////////

int Nsv = 596;
int vec_size = 10; // Write this manually to avoid unnecessarily complicated code
float gamma = 0.009;

// The intercept
float RO = -0.10134; 

// The support vector coefficients multiplied by 10,000. Note, all elements of the array should be max 65535, otherwise uint_16_t will overflow
const uint16_t alpha[] PROGMEM =  {
    776,  181,   88,  358,  222,  132,   29,  603,  901,  329,  936,  148,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  105

    };


// The support vectors. Note, all elements of the array should be max 65535, otherwise uint_16_t will overflow
const uint16_t SupportVectors[] PROGMEM = {
    4300,    3900,   26400,    4800,     700,    4460,    3820,   26260,    1640,     820,
    1500,    5200,   26400,    3100,    2900,    1240,    4140,   26200,    3740,    3880,
    4800,    3300,   26200,    4100,    3300,    4680,    3460,   26220,    4280,    4100,
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    1300,    3300,   26400,    3800,    2900,    1160,    3580,   26420,    3320,    2700
    };



// To run the I2C MUX.
void tcaselect ( uint8_t i2c_bus) {
  if (i2c_bus > 7 ) return;
  Wire.beginTransmission(MUX_Address);
  Wire.write(1 << i2c_bus);
  Wire.endTransmission();
  //delay(10);
}



void setup() {
  Serial.begin(9600);
  //  // To use a slightly lower 32V, 1A range (higher precision on amps):
  //  ina219.setCalibration_32V_1A();
  //  // Or to use a lower 16V, 400mA range (higher precision on volts and amps):
  //  //ina219.setCalibration_16V_400mA();

  tcaselect(1);
//  ina219_A1.begin();
//  ina219_A1.setCalibration_16V_400mA();
  ina219_B1.begin();
  ina219_B1.setCalibration_16V_400mA();
  ina219_C1.begin();
  ina219_C1.setCalibration_16V_400mA();

  tcaselect(2);
  ina219_A2.begin();
  ina219_A2.setCalibration_16V_400mA();
  ina219_B2.begin();
  ina219_B2.setCalibration_16V_400mA();
  ina219_C2.begin();
  ina219_C2.setCalibration_16V_400mA();

  pinMode(chipSelect, OUTPUT);
//  pinMode(alarm, OUTPUT);
  pinMode(HT_cont_pin, OUTPUT);
  pinMode(alarm2, OUTPUT);
  

  // see if the card is present and can be initialized:
  if (!SD.begin(chipSelect)) {
    Serial.println("SD fail");
    // don't do anything more:
    while (!SD.begin(chipSelect)) {
      digitalWrite (alarm2, 220);
      delay(50);
      digitalWrite (alarm2, 0);
      delay(500);
    }
  }
  
//  SD.begin(chipSelect);
//  digitalWrite (alarm, 0);

  PowConsFile = SD.open("PowCons.txt", FILE_WRITE);
  if (PowConsFile) {
    PowConsFile.println("New");
    PowConsFile.println("");
    PowConsFile.close();
  } else {
    Serial.println("No SD");
  }

}

float data_matrix[5][10] = {{0,0,0,0,0,0,0,0,0,0},  //Row 0
                            {0,0,0,0,0,0,0,0,0,0},  //Row 1
                            {0,0,0,0,0,0,0,0,0,0},  //Row 2
                            {0,0,0,0,0,0,0,0,0,0},  //Row 3
                            {0,0,0,0,0,0,0,0,0,0}}; //Row 4
//float data_matrix[1][5];


//float A1_power_mW;
//float B1_power_mW;
//float C1_power_mW;
//float A2_power_mW;
//float B2_power_mW;
//float C2_power_mW;

int y_pred;
int iteration = 0;                                                                 //REMOVE
int Stability_agent[5] = {-1,-1,-1,-1,-1};
float Agent_output;
int Agent_pred;
int HT_iter = 1;
int HT_status = 0;

void loop() {

  /////////////Control the HT on-off cycle//////////////
  
  if(HT_iter <=100){
    if(HT_status != -1){
      HT_status = -1; digitalWrite(HT_cont_pin, HIGH);
      delay(15);
    }
  }
  else if(HT_iter < 200){
    if (HT_status != 1){
      HT_status = 1; digitalWrite(HT_cont_pin, LOW);
      delay(15);
    }
  }
  else if(HT_iter == 200){
    digitalWrite(HT_cont_pin, LOW);
    HT_status = 1;
    HT_iter = 0;
  }
  HT_iter++;

  
 /////////////Shift data values down//////////////
  for(int column = 0; column < vec_size; column++){
    for(int row=3; row>=0; row--){
      data_matrix[row+1][column] = data_matrix[row][column];
    }
  }
  

// ///////////////Get new datapoint////////////////

  tcaselect(1);
//  A1_power_mW = ina219_A1.getPower_mW();
  data_matrix[0][0] = ina219_B1.getPower_mW(); //  B1_power_mW = ina219_B1.getPower_mW();
  data_matrix[0][1] = ina219_C1.getPower_mW(); //  C1_power_mW = ina219_C1.getPower_mW();

  tcaselect(2);
  data_matrix[0][2] = ina219_A2.getPower_mW(); //  A2_power_mW = ina219_A2.getPower_mW();
  data_matrix[0][3] = ina219_B2.getPower_mW(); //  B2_power_mW = ina219_B2.getPower_mW();
  data_matrix[0][4] = ina219_C2.getPower_mW(); //  C2_power_mW = ina219_C2.getPower_mW();


// /////////////Calculate moving averages//////////////

  for(int k=5; k<vec_size; k++){
    data_matrix[0][k] = (data_matrix[0][k-5]+data_matrix[1][k-5]+data_matrix[2][k-5]+data_matrix[3][k-5]+data_matrix[4][k-5])/5.0;
  }


// ///////////////Process new datapoint////////////////

  float new_point[10] = {data_matrix[0][0], data_matrix[0][1], data_matrix[0][2], data_matrix[0][3], data_matrix[0][4], data_matrix[0][5], data_matrix[0][6], data_matrix[0][7], data_matrix[0][8], data_matrix[0][9]};
//  float new_point[5] = {data_matrix[0][0], data_matrix[0][1], data_matrix[0][2], data_matrix[0][3], data_matrix[0][4]};


  // Calculate the decision function value: BIGsum
  float BIGsum = 0.0;
  unsigned int displayInt;
  int counter = 0;
  float x;

  iteration++;                                          //REMOVE
//  debugFile = SD.open("debug.txt", FILE_WRITE);         //REMOVE
//  if (debugFile) {                                      //REMOVE
//    debugFile.println("==============");                //REMOVE
////    debugFile.print("       Iteration: ");              //REMOVE
//    debugFile.println(iteration);                       //REMOVE
////    debugFile.println("                             "); //REMOVE
//    debugFile.close();                                  //REMOVE
//  }                                                     //REMOVE

  
  for(int row=0; row<Nsv; row++){ //  AAA

    // Find the square of Euclidean distance between the new point and one of the SVs.
    float Euc_norm_sq = 0.0;
    
    for (int k = row*vec_size; k < (row*vec_size)+vec_size; k++) {// BBB
      displayInt = pgm_read_word_near(SupportVectors + k);
      
      x = displayInt/100.00 - new_point[counter]; // keep other operations outside the sq function
      Euc_norm_sq += sq(x);
      counter++;
      
    }
//    Euc_norm_sq = sqrt(Euc_norm_sq); // This is the (final) calculated distance!!! OR IS IT??
    
//    debugFile = SD.open("debug.txt", FILE_WRITE);         //REMOVE
//    if (debugFile) {                                      //REMOVE
//      debugFile.println("");                              //REMOVE
//      debugFile.close();                                  //REMOVE
//    }                                                     //REMOVE
    
    
    counter = 0;
    float astichan = - gamma * Euc_norm_sq;
    float kernel_value = exp(astichan);
    float alf = pgm_read_word_near(alpha + row)/10000.0; // Fetch from Flash memory location: address(alpha) + row
    BIGsum += alf * kernel_value;


  

//    debugFile = SD.open("debug.txt", FILE_WRITE);         //REMOVE
//    if (debugFile) {                                      //REMOVE
//      debugFile.print(Euc_norm_sq);                       //REMOVE
//      debugFile.print(", ");                              //REMOVE
//      debugFile.print(astichan);                          //REMOVE
//      debugFile.print(", ");                              //REMOVE
//      debugFile.print(kernel_value, 4);                   //REMOVE
//      debugFile.print(",  ");                             //REMOVE
//      debugFile.print(alf, 4);                            //REMOVE
//      debugFile.print(", ");                              //REMOVE
//      debugFile.print(BIGsum, 4);                         //REMOVE
//      debugFile.println(";");                             //REMOVE
//      debugFile.close();                                  //REMOVE
//    }                                                     //REMOVE
    
  }


  
  BIGsum = BIGsum + RO;
  // Return the results
  if (BIGsum <0 ){
    // Ring the HT alarm
    y_pred = -1;
//    digitalWrite (alarm, 220);
    } else{
    y_pred = 1;
//    digitalWrite (alarm, 0);
    
  }
  
  /////////////////// Stex avelacru stability agent-i array-@ //////////////////////
  Stability_agent[0] = Stability_agent[1];
  Stability_agent[1] = Stability_agent[2];
  Stability_agent[2] = Stability_agent[3];
  Stability_agent[3] = Stability_agent[4];
  Stability_agent[4] = y_pred;
  Agent_output = Stability_agent[0] + Stability_agent[1] + Stability_agent[2] + Stability_agent[3] + Stability_agent[4];
  
  // Agent prediction result
  if (Agent_output <0 ){
    Agent_pred = -1;  digitalWrite (alarm2, 220);
    } else{
    Agent_pred = 1;  digitalWrite (alarm2, 0);
  }
  
  //////////////////////////////////////////////////////////////////////////////////




    
//////////////////////////////////////////////////////


  //  TimingFile = SD.open("Timefile.txt", FILE_WRITE);
  //  if(TimingFile){
  //    //TimingFile.print(t1);
  //    //TimingFile.print(",  ");
  //    //TimingFile.print(t2);
  //    //TimingFile.print(",  ");
  //    //TimingFile.print(t2 - t1);
  //    //TimingFile.print(",  ");
  //    //TimingFile.print(t3 - t2);
  //    //TimingFile.print(",  ");
  //    TimingFile.println(t4 - t1);
  //  }
  //  TimingFile.close();


  //  // see if the card is present and can be initialized:
  //  if (!SD.begin(chipSelect)) {
  //    Serial.println("Card failed, or not present");
  //    // don't do anything more:
  //    while (!SD.begin(chipSelect)){
  //      digitalWrite (alarm, 220);
  //      delay(50);
  //      digitalWrite (alarm, 0);
  //      delay(500);
  //      }
  //  }


// ///////////////Save info to .txt files////////////////

  PowConsFile = SD.open("PowCons.txt", FILE_WRITE);
  if (PowConsFile) {
    PowConsFile.print(iteration);            PowConsFile.print("), ");    //REMOVE
//    PowConsFile.print(A1_power_mW);          PowConsFile.print(", ");
    PowConsFile.print(data_matrix[0][0]);    PowConsFile.print(", ");
    PowConsFile.print(data_matrix[0][1]);    PowConsFile.print(", ");
    PowConsFile.print(data_matrix[0][2]);    PowConsFile.print(", ");
    PowConsFile.print(data_matrix[0][3]);    PowConsFile.print(", ");
    PowConsFile.print(data_matrix[0][4]);    PowConsFile.print(", ");
    PowConsFile.print(data_matrix[0][5]);    PowConsFile.print(", ");
    PowConsFile.print(data_matrix[0][6]);    PowConsFile.print(", ");
    PowConsFile.print(data_matrix[0][7]);    PowConsFile.print(", ");
    PowConsFile.print(data_matrix[0][8]);    PowConsFile.print(", ");
    PowConsFile.print(data_matrix[0][9]);    PowConsFile.print(", ");
    PowConsFile.print(y_pred);               PowConsFile.print(", ");
    PowConsFile.print(BIGsum, 6);            PowConsFile.print(", ");
    PowConsFile.print(Agent_pred);           PowConsFile.print(", ");
    PowConsFile.println(HT_status);
    PowConsFile.close();
  } else {
    Serial.println("No SD");
  }


}
